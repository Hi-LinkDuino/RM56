## drivers/framework/sample/platform/uart/Kconfig
```kconfig
# Copyright (c) 2021 Huawei Device Co., Ltd.
#
# HDF is dual licensed: you can use it either under the terms of
# the GPL, or the BSD license, at your option.
# See the LICENSE file in the root of this repository for complete details.

config DRIVERS_HDF_PLATFORM_UART_SAMPLE
    bool "Enable HDF platform uart sample driver"
    default n
    depends on DRIVERS_HDF_PLATFORM
    help
      Answer Y to enable HDF platform uart sample driver.
```

## rtos/liteos/liteos_a/platform/Kconfig
```kconfig
config PLATFORM
    string "bes2600w"
    default "hi3516dv300"     if PLATFORM_HI3516DV300
    default "hi3518ev300"     if PLATFORM_HI3518EV300
    default "virt"            if PLATFORM_QEMU_ARM_VIRT_CA7
    default "bes2600w"        if PLATFORM_BES2600W

config PRODUCT_NAME
    string "bes2600w"
    default "ipcamera_hi3516dv300_liteos" if PRODUCT_IPCAMERA_HI3516DV300_LITEOS
    default "ipcamera_hi3518ev300_liteos" if PRODUCT_IPCAMERA_HI3518EV300_LITEOS
    default "hispark_taurus" if PRODUCT_HISPARK_TAURUS
    default "hispark_aries" if PRODUCT_HISPARK_ARIES
    default "arm_virt" if PRODUCT_QEMU_ARM
    default "bes2600w" if PRODUCT_BES2600W

config DEVICE_COMPANY
    string "bes"
    default "hisilicon" if PLATFORM_HI3516DV300
    default "hisilicon" if PLATFORM_HI3518EV300
    default "qemu" if PLATFORM_QEMU_ARM_VIRT_CA7
    default "bes" if PLATFORM_BES2600W

choice
    prompt "Chip"
    default PLATFORM_HI3516DV300
    help
      IPC has several chips:
      hi3516dv300
      hi3518ev300
      Qemu ARM Virt variants (based on different CPU types):
      qemu_arm_virt_ca7
      bes2600w

config PLATFORM_BES2600W
    bool "bes2600w"
    select ARCH_CORTEX_A7

config PLATFORM_HI3516DV300
    bool "hi3516dv300"
    select ARCH_CORTEX_A7

config PLATFORM_HI3518EV300
    bool "hi3518ev300"
    select ARCH_CORTEX_A7

config PLATFORM_QEMU_ARM_VIRT_CA7
    bool "qemu_arm_virt_ca7"
    select ARCH_CORTEX_A7
    help
        QEMU ARM Virtual Platform using Cortex-A7 CPU.
endchoice

choice
    prompt "Product"
    help
      Select your target board.

config PRODUCT_IPCAMERA_HI3516DV300_LITEOS
    bool "ipcamera_hi3516dv300_liteos" if PLATFORM_HI3516DV300
config PRODUCT_HISPARK_TAURUS
    bool "hispark_taurus" if PLATFORM_HI3516DV300

config PRODUCT_IPCAMERA_HI3518EV300_LITEOS
    bool "ipcamera_hi3518ev300_liteos" if PLATFORM_HI3518EV300
config PRODUCT_HISPARK_ARIES
    bool "hispark_aries" if PLATFORM_HI3518EV300

config PRODUCT_QEMU_ARM
    bool "arm_virt" if PLATFORM_QEMU_ARM_VIRT_CA7

config PRODUCT_BES2600W
    bool "bes2600w liteos" if PLATFORM_BES2600W
endchoice

config BOARD_CONFIG_PATH
    string "BOARD CONFIG PATH"
    default "config/board"

config TEE_ENABLE
    bool "ENABLE TEE"
    default n
    depends on PLATFORM_HI3516DV300
    help
        ENABLE teeos in platform

config HRTIMER_ENABLE
    bool "HR TIMER enable"
    default y
    help
      Enable High-resolution timer support
```
