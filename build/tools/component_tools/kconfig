## device/board/fnlink/v200zr/liteos_m/drivers/Kconfig
```kconfig
# Copyright (c) 2021 FnLink (hunan) Technologies CO., LIMITED.
# Licensed under the Apache License, Version 2.0 (the "License");
# you may not use this file except in compliance with the License.
# You may obtain a copy of the License at
#
#     http://www.apache.org/licenses/LICENSE-2.0
#
# Unless required by applicable law or agreed to in writing, software
# distributed under the License is distributed on an "AS IS" BASIS,
# WITHOUT WARRANTIES OR CONDITIONS OF ANY KIND, either express or implied.
# See the License for the specific language governing permissions and
# limitations under the License.

config DRIVERS_HDF_PLATFORM_DISPLAY
    bool "Enable diplay driver"
    default n
    depends on DRIVERS_HDF_PLATFORM_MIPI_DSI
    help
      Answer Y to enable diplay driver.

config DRIVERS_HDF_PLATFORM_TOUCH
    bool "Enable touch driver"
    default n
    depends on DRIVERS_HDF_PLATFORM_I2C
    help
      Answer Y to enable touch driver.

config DRIVERS_HDF_PLATFORM_UI
    bool "Enable ui driver"
    default n
    depends on DRIVERS_HDF_PLATFORM_DISPLAY
    help
      Answer Y to enable ui driver.
```

## drivers/adapter/khdf/liteos/Kconfig
```kconfig
# Copyright (c) 2020-2021 Huawei Device Co., Ltd. All rights reserved.
#
# Redistribution and use in source and binary forms, with or without modification,
# are permitted provided that the following conditions are met:
#
# 1. Redistributions of source code must retain the above copyright notice, this list of
#    conditions and the following disclaimer.
#
# 2. Redistributions in binary form must reproduce the above copyright notice, this list
#    of conditions and the following disclaimer in the documentation and/or other materials
#    provided with the distribution.
#
# 3. Neither the name of the copyright holder nor the names of its contributors may be used
#    to endorse or promote products derived from this software without specific prior written
#    permission.
#
# THIS SOFTWARE IS PROVIDED BY THE COPYRIGHT HOLDERS AND CONTRIBUTORS
# "AS IS" AND ANY EXPRESS OR IMPLIED WARRANTIES, INCLUDING, BUT NOT LIMITED TO,
# THE IMPLIED WARRANTIES OF MERCHANTABILITY AND FITNESS FOR A PARTICULAR
# PURPOSE ARE DISCLAIMED. IN NO EVENT SHALL THE COPYRIGHT HOLDER OR
# CONTRIBUTORS BE LIABLE FOR ANY DIRECT, INDIRECT, INCIDENTAL, SPECIAL,
# EXEMPLARY, OR CONSEQUENTIAL DAMAGES (INCLUDING, BUT NOT LIMITED TO,
# PROCUREMENT OF SUBSTITUTE GOODS OR SERVICES; LOSS OF USE, DATA, OR PROFITS;
# OR BUSINESS INTERRUPTION) HOWEVER CAUSED AND ON ANY THEORY OF LIABILITY,
# WHETHER IN CONTRACT, STRICT LIABILITY, OR TORT (INCLUDING NEGLIGENCE OR
# OTHERWISE) ARISING IN ANY WAY OUT OF THE USE OF THIS SOFTWARE, EVEN IF
# ADVISED OF THE POSSIBILITY OF SUCH DAMAGE.

menuconfig DRIVERS_HDF
    bool "HDF driver framework support"
    default n
    depends on DRIVERS
    help
      Answer Y to enable LiteOS support HDF.
if DRIVERS_HDF
config DRIVERS_HDF_PLATFORM
    bool "Enable HDF platform driver"
    default n
    depends on DRIVERS_HDF
    help
      Answer Y to enable HDF platform driver.

config DRIVERS_HDF_PLATFORM_GPIO
    bool "Enable HDF platform gpio driver"
    default n
    depends on DRIVERS_HDF_PLATFORM
    help
      Answer Y to enable HDF platform gpio driver.

config DRIVERS_HDF_PLATFORM_PIN
    bool "Enable HDF platform pin driver"
    default n
    depends on DRIVERS_HDF_PLATFORM
    help
      Answer Y to enable HDF platform pin driver.

config DRIVERS_HDF_PLATFORM_I2C
    bool "Enable HDF platform i2c driver"
    default n
    depends on DRIVERS_HDF_PLATFORM
    help
      Answer Y to enable HDF platform i2c driver.

config DRIVERS_HDF_PLATFORM_REGULATOR
    bool "Enable HDF platform regulator driver"
    default n
    depends on DRIVERS_HDF_PLATFORM
    help
      Answer Y to enable HDF platform regulator driver.

config DRIVERS_HDF_PLATFORM_ADC
    bool "Enable HDF platform adc driver"
    default n
    depends on DRIVERS_HDF_PLATFORM
    help
      Answer Y to enable HDF platform adc driver.

config DRIVERS_HDF_PLATFORM_DAC
    bool "Enable HDF platform dac driver"
    default n
    depends on DRIVERS_HDF_PLATFORM
    help
      Answer Y to enable HDF platform dac driver.

config DRIVERS_HDF_PLATFORM_I3C
    bool "Enable HDF platform i3c driver"
    default n
    depends on DRIVERS_HDF_PLATFORM
    help
      Answer Y to enable HDF platform i3c driver.

config DRIVERS_HDF_PLATFORM_MMC
    bool "Enable HDF platform mmc driver"
    default n
    depends on DRIVERS_HDF_PLATFORM
    help
      Answer Y to enable HDF platform mmc driver.

config DRIVERS_HDF_PLATFORM_EMMC
    bool "Enable HDF platform emmc driver"
    default n
    depends on DRIVERS_HDF_PLATFORM
    help
      Answer Y to enable HDF platform emmc driver.

config DRIVERS_HDF_PLATFORM_PWM
    bool "Enable HDF platform pwm driver"
    depends on DRIVERS_HDF_PLATFORM
    help
      Answer Y to enable HDF platform pwm driver.

config DRIVERS_HDF_PLATFORM_RTC
    bool "Enable HDF platform rtc driver"
    default n
    depends on DRIVERS_HDF_PLATFORM
    help
      Answer Y to enable HDF platform rtc driver.

config DRIVERS_HDF_PLATFORM_SDIO
    bool "Enable HDF platform sdio driver"
    default n
    depends on DRIVERS_HDF_PLATFORM && DRIVERS_HDF_PLATFORM_MMC
    help
      Answer Y to enable HDF platform sdio driver.

config DRIVERS_HDF_PLATFORM_DMAC
    bool "Enable HDF platform dmac driver"
        default n
    depends on DRIVERS_HDF_PLATFORM
        help
      Answer Y to enable HDF platform dmac driver.

config DRIVERS_HDF_PLATFORM_MIPI_DSI
    bool "Enable HDF platform mipi dsi driver"
    default n
    depends on DRIVERS_HDF_PLATFORM
    help
      Answer Y to enable HDF platform mipi dsi driver.

config DRIVERS_HDF_PLATFORM_MIPI_CSI
    bool "Enable HDF platform mipi csi driver"
    default n
    depends on DRIVERS_HDF_PLATFORM
    help
      Answer Y to enable HDF platform mipi csi driver.

config DRIVERS_HDF_PLATFORM_HISI_SDK
    bool "Enable HDF hisi sdk driver"
    default n
    depends on DRIVERS_HDF_PLATFORM
    help
      Answer Y to enable HDF hisi sdk driver.

config DRIVERS_HDF_PLATFORM_SPI
    bool "Enable HDF platform spi driver"
    default n
    depends on DRIVERS_HDF_PLATFORM
    help
      Answer Y to enable HDF platform spi driver.

config DRIVERS_HDF_PLATFORM_I2S
    bool "Enable HDF platform i2s driver"
    default n
    depends on DRIVERS_HDF_PLATFORM
    help
      Answer Y to enable HDF platform i2s driver.

config DRIVERS_HDF_PLATFORM_HDMI
    bool "Enable HDF platform hdmi driver"
    default n
    depends on DRIVERS_HDF_PLATFORM
    help
      Answer Y to enable HDF platform hdmi driver.

config DRIVERS_HDF_PLATFORM_PCIE
    bool "Enable HDF platform pcie driver"
    default n
    depends on DRIVERS_HDF_PLATFORM
    help
      Answer Y to enable HDF platform pcie driver.

config DRIVERS_HDF_PLATFORM_WATCHDOG
    bool "Enable HDF platform watchdog driver"
    default n
    depends on DRIVERS_HDF_PLATFORM
    help
      Answer Y to enable HDF platform watchdog driver.
      
config DRIVERS_HDF_PLATFORM_TIMER
    bool "Enable HDF platform timer driver"
    default n
    depends on DRIVERS_HDF_PLATFORM
    help
      Answer Y to enable HDF platform timer driver.

config DRIVERS_HIEDMAC
    bool "Enable HIEDMAC"
    default n
    depends on DRIVERS && PLATFORM_HI3559AV100
    help
      Answer Y to enable LiteOS support hiedmac.
source "../../drivers/adapter/khdf/liteos/model/storage/Kconfig"
source "../../drivers/adapter/khdf/liteos/test/Kconfig"

config DRIVERS_HDF_WIFI
    bool "Enable HDF WiFi Host driver"
    default n
    depends on DRIVERS_HDF && NET_LWIP_SACK && DRIVERS_HDF_PLATFORM_SDIO
    help
      Answer Y to enable HDF WiFi Host driver.

source "../../drivers/adapter/khdf/liteos/model/bus/usb/Kconfig"
source "../../drivers/adapter/khdf/liteos/model/display/Kconfig"
source "../../drivers/adapter/khdf/liteos/model/input/Kconfig"
source "../../drivers/adapter/khdf/liteos/model/sensor/Kconfig"
source "../../drivers/adapter/khdf/liteos/model/misc/dsoftbus/Kconfig"
source "../../drivers/adapter/khdf/liteos/model/misc/light/Kconfig"
source "../../drivers/adapter/khdf/liteos/model/misc/vibrator/Kconfig"
source "../../drivers/adapter/khdf/liteos/model/usb/device/Kconfig"
source "../../drivers/adapter/khdf/liteos/model/usb/host/Kconfig"
source "../../drivers/adapter/khdf/liteos/model/audio/Kconfig"
endif
```

## drivers/adapter/khdf/liteos/model/sensor/Kconfig
```kconfig
# Copyright (c) 2021 Huawei Device Co., Ltd. All rights reserved.
#
# Redistribution and use in source and binary forms, with or without modification,
# are permitted provided that the following conditions are met:
#
# 1. Redistributions of source code must retain the above copyright notice, this list of
#    conditions and the following disclaimer.
#
# 2. Redistributions in binary form must reproduce the above copyright notice, this list
#    of conditions and the following disclaimer in the documentation and/or other materials
#    provided with the distribution.
#
# 3. Neither the name of the copyright holder nor the names of its contributors may be used
#    to endorse or promote products derived from this software without specific prior written
#    permission.
#
# THIS SOFTWARE IS PROVIDED BY THE COPYRIGHT HOLDERS AND CONTRIBUTORS
# "AS IS" AND ANY EXPRESS OR IMPLIED WARRANTIES, INCLUDING, BUT NOT LIMITED TO,
# THE IMPLIED WARRANTIES OF MERCHANTABILITY AND FITNESS FOR A PARTICULAR
# PURPOSE ARE DISCLAIMED. IN NO EVENT SHALL THE COPYRIGHT HOLDER OR
# CONTRIBUTORS BE LIABLE FOR ANY DIRECT, INDIRECT, INCIDENTAL, SPECIAL,
# EXEMPLARY, OR CONSEQUENTIAL DAMAGES (INCLUDING, BUT NOT LIMITED TO,
# PROCUREMENT OF SUBSTITUTE GOODS OR SERVICES; LOSS OF USE, DATA, OR PROFITS;
# OR BUSINESS INTERRUPTION) HOWEVER CAUSED AND ON ANY THEORY OF LIABILITY,
# WHETHER IN CONTRACT, STRICT LIABILITY, OR TORT (INCLUDING NEGLIGENCE OR
# OTHERWISE) ARISING IN ANY WAY OUT OF THE USE OF THIS SOFTWARE, EVEN IF
# ADVISED OF THE POSSIBILITY OF SUCH DAMAGE.

config DRIVERS_HDF_SENSOR
    bool "Enable HDF sensor driver"
    default n
    depends on DRIVERS_HDF
    help
      Answer Y to enable HDF sensor driver.

config DRIVERS_HDF_SENSOR_ACCEL
    bool "Enable HDF accel sensor driver"
    default n
    depends on DRIVERS_HDF_SENSOR
    help
      Answer Y to enable HDF accel sensor driver.
config DRIVERS_HDF_SENSOR_ACCEL_BMI160
    bool "Enable HDF accel bmi160 sensor driver"
    default n
    depends on DRIVERS_HDF_SENSOR_ACCEL
    help
      Answer Y to enable HDF accel bmi160 sensor driver.
config DRIVERS_HDF_SENSOR_ALS
    bool "Enable HDF als sensor driver"
    default n
    depends on DRIVERS_HDF_SENSOR
    help
      Answer Y to enable HDF als sensor driver.
config DRIVERS_HDF_SENSOR_ALS_BH1745
    bool "Enable HDF als bh1745 sensor driver"
    default n
    depends on DRIVERS_HDF_SENSOR_ALS
    help
      Answer Y to enable HDF als bh1745 sensor driver.
config DRIVERS_HDF_SENSOR_PROXIMITY
    bool "Enable HDF proximity sensor driver"
    default n
    depends on DRIVERS_HDF_SENSOR
    help
      Answer Y to enable HDF proximity sensor driver.
config DRIVERS_HDF_SENSOR_PROXIMITY_APDS9960
    bool "Enable HDF proximity adps9960 sensor driver"
    default n
    depends on DRIVERS_HDF_SENSOR_PROXIMITY
    help
      Answer Y to enable HDF proximity apds9960 sensor driver.
config DRIVERS_HDF_SENSOR_GRAVITY
    bool "Enable HDF gravity sensor driver"
    default n
    depends on DRIVERS_HDF_SENSOR_ACCEL
    help
      Answer Y to enable HDF gravity sensor driver.
config DRIVERS_HDF_SENSOR_GYRO
    bool "Enable HDF gyro sensor driver"
    default n
    depends on DRIVERS_HDF_SENSOR
    help
      Answer Y to enable HDF gyro sensor driver.
config DRIVERS_HDF_SENSOR_BAROMETER
    bool "Enable HDF barometer sensor driver"
    default n
    depends on DRIVERS_HDF_SENSOR
    help
      Answer Y to enable HDF barometer sensor driver.
config DRIVERS_HDF_SENSOR_BAROMETER_BMP180
    bool "Enable HDF barometer bmp180 sensor driver"
    default n
    depends on DRIVERS_HDF_SENSOR_BAROMETER
    help
      Answer Y to enable HDF barometer bmp180 sensor driver.
config DRIVERS_HDF_SENSOR_HALL
    bool "Enable HDF hall sensor driver"
    default n
    depends on DRIVERS_HDF_SENSOR
    help
      Answer Y to enable HDF hall sensor driver.
config DRIVERS_HDF_SENSOR_HALL_AK8789
    bool "Enable HDF hall ak8789 sensor driver"
    default n
    depends on DRIVERS_HDF_SENSOR_HALL
    help
      Answer Y to enable HDF hall ak8789 sensor driver.
config DRIVERS_HDF_SENSOR_MAGNETIC
    bool "Enable HDF magnetic sensor driver"
    default n
    depends on DRIVERS_HDF_SENSOR
    help
      Answer Y to enable HDF magnetic sensor driver.
config DRIVERS_HDF_SENSOR_MAGNETIC_LSM303
    bool "Enable HDF magnetic lsm303 sensor driver"
    default n
    depends on DRIVERS_HDF_SENSOR_MAGNETIC
    help
      Answer Y to enable HDF magnetic lsm303 sensor driver.
```

## drivers/adapter/khdf/liteos/model/usb/device/Kconfig
```kconfig
# Copyright (c) 2020-2021 Huawei Device Co., Ltd. All rights reserved.
#
# Redistribution and use in source and binary forms, with or without modification,
# are permitted provided that the following conditions are met:
#
# 1. Redistributions of source code must retain the above copyright notice, this list of
#    conditions and the following disclaimer.
#
# 2. Redistributions in binary form must reproduce the above copyright notice, this list
#    of conditions and the following disclaimer in the documentation and/or other materials
#    provided with the distribution.
#
# 3. Neither the name of the copyright holder nor the names of its contributors may be used
#    to endorse or promote products derived from this software without specific prior written
#    permission.
#
# THIS SOFTWARE IS PROVIDED BY THE COPYRIGHT HOLDERS AND CONTRIBUTORS
# "AS IS" AND ANY EXPRESS OR IMPLIED WARRANTIES, INCLUDING, BUT NOT LIMITED TO,
# THE IMPLIED WARRANTIES OF MERCHANTABILITY AND FITNESS FOR A PARTICULAR
# PURPOSE ARE DISCLAIMED. IN NO EVENT SHALL THE COPYRIGHT HOLDER OR
# CONTRIBUTORS BE LIABLE FOR ANY DIRECT, INDIRECT, INCIDENTAL, SPECIAL,
# EXEMPLARY, OR CONSEQUENTIAL DAMAGES (INCLUDING, BUT NOT LIMITED TO,
# PROCUREMENT OF SUBSTITUTE GOODS OR SERVICES; LOSS OF USE, DATA, OR PROFITS;
# OR BUSINESS INTERRUPTION) HOWEVER CAUSED AND ON ANY THEORY OF LIABILITY,
# WHETHER IN CONTRACT, STRICT LIABILITY, OR TORT (INCLUDING NEGLIGENCE OR
# OTHERWISE) ARISING IN ANY WAY OUT OF THE USE OF THIS SOFTWARE, EVEN IF
# ADVISED OF THE POSSIBILITY OF SUCH DAMAGE.

config DRIVERS_HDF_USB_DDK_DEVICE
    bool "Enable HDF LiteOS USB DDK Device driver"
    default n
    depends on DRIVERS_HDF && DRIVERS_USB && DRIVERS_HDF_USB_COMPOSITE
    help
        Answer Y to choice HDF LiteOS USB DDK Device driver.

config DRIVERS_HDF_USB_COMPOSITE
    bool "Enable HDF usb composite driver framework"
    default n
    depends on DRIVERS_HDF && DRIVERS_USB
    help
      Answer Y to enable HDF usb composite driver framework.

config DRIVERS_USB3_DEVICE_CONTROLLER
    bool "Enable HDF usb3 controller driver"
    default n
    depends on DRIVERS_HDF && DRIVERS_USB
    help
      Answer Y to enable HDF usb controller driver.

config DRIVERS_HDF_USB_DEVICE_DEMO_TEST
    bool "Enable HDF usb device driver demo test"
    default n
    depends on DRIVERS_HDF && DRIVERS_USB && DRIVERS_HDF_USB_DDK_DEVICE
    help
      Answer Y to enable HDF usb device driver demo.
```
